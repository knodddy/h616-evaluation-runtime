## boot/h616-eval_defconfig
```kconfig
CONFIG_ARM=y
CONFIG_ARCH_SUNXI=y
CONFIG_DEFAULT_DEVICE_TREE="allwinner/sun50i-h616-eval"
CONFIG_SPL=y
CONFIG_MACH_SUN50I_H616=y
CONFIG_SUNXI_DRAM_H616_DDR3_1333=y
CONFIG_DRAM_CLK=600
# shortcut: Orange Pi Zero2 training parameters; calibrate against the assembled board.
CONFIG_DRAM_SUNXI_DX_ODT=0x08080808
CONFIG_DRAM_SUNXI_DX_DRI=0x0e0e0e0e
CONFIG_DRAM_SUNXI_CA_DRI=0x0e0e
CONFIG_DRAM_SUNXI_TPR6=0x33808080
CONFIG_DRAM_SUNXI_TPR10=0xf83438
CONFIG_SYS_CLK_FREQ=600000000
CONFIG_R_I2C_ENABLE=y
CONFIG_SPL_I2C=y
CONFIG_SPL_SYS_I2C_LEGACY=y
CONFIG_SYS_I2C_MVTWSI=y
CONFIG_SYS_I2C_SLAVE=0x7f
CONFIG_SYS_I2C_SPEED=400000
CONFIG_AXP313_POWER=y
CONFIG_AXP_DCDC2_VOLT=1000
CONFIG_AXP_DCDC3_VOLT=1500
CONFIG_BOOTDELAY=-1
CONFIG_ENV_IS_NOWHERE=y
# CONFIG_ENV_IS_IN_FAT is not set
# CONFIG_NET is not set
# CONFIG_TOOLS_MKEFICAPSULE is not set
# CONFIG_SYS_MALLOC_CLEAR_ON_INIT is not set
```

## boot/h616.its
```
/dts-v1/;

/ {
	description = "H616 runtime firmware";
	#address-cells = <1>;

	images {
		runtime {
			description = "H616 runtime";
			data = /incbin/("../build/h616-runtime.bin");
			type = "standalone";
			os = "u-boot";
			arch = "arm64";
			compression = "none";
			load = <0x4a000000>;
			entry = <0x4a000000>;
		};

		atf {
			description = "ARM Trusted Firmware";
			data = /incbin/("../build/firmware/tf-a/build/sun50i_h616/release/bl31.bin");
			type = "firmware";
			os = "arm-trusted-firmware";
			arch = "arm64";
			compression = "none";
			load = <0x40000000>;
			entry = <0x40000000>;
		};

		fdt {
			description = "allwinner/sun50i-h616-eval";
			data = /incbin/("../build/h616.dtb");
			type = "flat_dt";
			arch = "arm64";
			compression = "none";
		};
	};

	configurations {
		default = "config-1";
		config-1 {
			description = "allwinner/sun50i-h616-eval";
			firmware = "atf";
			loadables = "runtime";
			fdt = "fdt";
		};
	};
};
```
